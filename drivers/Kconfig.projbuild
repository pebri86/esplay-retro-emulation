## drivers/Kconfig.projbuild
```kconfig
menu "LittleV Graphics Library"

config USE_LVGL_LIBRARY
	bool "Use LVGL library"

config USE_LVGL
	int
	default 1 if USE_LVGL_LIBRARY

endmenu

menu "SDCard Configuration"

config SDIO_DAT2_DISABLED
    bool "Disable the DAT2 in SDIO slave"
    default y
    help
        SDIO slave DAT pin is unfortunately the same pin as MTDI, which
        controls the flash power voltage. For 3.3v flash devkits / modules /
        kits, it conflicts with the DAT2 pullups required by the
        specification.
        
        This disables the peripheral input from the DAT2 so that we can work
        in 1-bit mode when DAT2 is floating (pulled down). 4-bit mode is
        therefore unavailable.

endmenu
```

## esplay-sdk/esplay-components/esplay-hal/Kconfig.projbuild
```kconfig
menu "Hardware configuration"

choice EMULATOR_HARDWARE
	prompt "Hardware to run on"
	default ESPLAY_MICRO_HW
	help
		This emulator can run on various types of hardware. Select what you have here.

config ESPLAY20_HW
	bool "ESPlay 2.0 Hardware"

config ESPLAY_MICRO_HW
	bool "ESPlay Micro Hardware"

config HW_CUSTOM
	bool "Custom hardware"

endchoice

choice HW_LCD_TYPE_SEL
	prompt "LCD type"
	default HW_LCD_TYPE_ILI9341
	depends on HW_CUSTOM

config HW_LCD_TYPE_ILI9341
	bool "ILI9341 LCD"

config HW_LCD_TYPE_ILI9342
	bool "ILI9342 LCD"

endchoice

config HW_LCD_TYPE
	int
	default 0 if ESPLAY20_HW
  default 0 if ESPLAY_MICRO_HW
	default 0 if HW_LCD_TYPE_ILI9341
	default 1 if HW_LCD_TYPE_ILI9342

endmenu
```

## esplay-sdk/esplay-components/ugui/Kconfig.projbuild
```kconfig
menu "8bkc uGui config"


config USE_FONT_4X6
	bool "4x6 font"
	default n

config USE_FONT_5X8
	bool "5x8 font"
	default n

config USE_FONT_5X12
	bool "5x12 font"
	default n

config USE_FONT_6X8
	bool "6x8 font"
	default y

config USE_FONT_6X10
	bool "6x10 font"
	default n

config USE_FONT_7X12
	bool "7x12 font"
	default n

config USE_FONT_8X8
	bool "8x8 font"
	default n

config USE_FONT_8X12
	bool "8x12 font"
	default n

config USE_FONT_8X12
	bool "8x12 font"
	default n

config USE_FONT_8X14
	bool "8x14 font"
	default n

config USE_FONT_10X16
	bool "10x16 font"
	default n

config USE_FONT_12X16
	bool "12x16 font"
	default n

config USE_FONT_12X20
	bool "12x20 font"
	default n

config USE_FONT_16X26
	bool "16x26 font"
	default n

config USE_FONT_22X36
	bool "22x36 font"
	default n

config USE_FONT_24X40
	bool "24x20 font"
	default n

config USE_FONT_32X53
	bool "32x53 ont"
	default n

endmenu
```
